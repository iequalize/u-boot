## board/tqc/tqma28/Kconfig
```kconfig
if TARGET_TQMA28

config SYS_ARCH
	default "arm"

config SYS_BOARD
	default "tqma28"

config SYS_VENDOR
	default "tqc"

config SYS_CPU
	default "arm926ejs"

config SYS_SOC
	default "mxs"

config SYS_CONFIG_NAME
	default "tqma28"

choice
	prompt "RAM size"
	optional
	help
		Select RAM size on your module.

config TQMA28_128MB
	bool "128 MB"

config TQMA28_256MB
	bool "256 MB"

endchoice

choice
	prompt "Base board variant"
	optional
	help
	  Select base board for TQMa28 module

config TQMA28_MBA28
	bool "TQMa28 on MBa28 Starterkit"
	help
	  Select the MBa28 starterkit. This features a Ethernet, USB, SD-Card, etc.

endchoice

endif
```

## board/tqc/tqma28l/Kconfig
```kconfig
if TARGET_TQMA28L

config SYS_ARCH
	default "arm"

config SYS_BOARD
	default "tqma28l"

config SYS_VENDOR
	default "tqc"

config SYS_CPU
	default "arm926ejs"

config SYS_SOC
	default "mxs"

config SYS_CONFIG_NAME
	default "tqma28l"

config TQMA28L_AA
	bool "TQMa28L-AA"
	help
	  select TQMa28L-AA variant: i.MX287 with ETH1 port and AUART3

choice
	prompt "TQMa28L base board variant"
	optional
	help
	  Select base board for TQMa28L

config TQMA28L_MBA28L
	bool "TQMa28L on MBa28(L) Starterkit"
	help
	  Select the MBa28L starterkit. It is a standard MBa28 kit mounted with
	  a TQMa28L module. This features a Ethernet, USB, SD-Card, etc.

config TQMA28L_NONE
	bool "TQMa28L without baseboard interface support"
	help
	  This option builds U-Boot without any support for baseboard specific
	  interfaces. Only devices on the module will be available.

endchoice

endif
```

## configs/tqma28_mba28_defconfig
```kconfig
CONFIG_ARM=y
CONFIG_TARGET_TQMA28=y
CONFIG_TQMA28_128MB=y
CONFIG_TQMA28_MBA28=y
CONFIG_SPL=y
CONFIG_SYS_EXTRA_OPTIONS="MXS_AUART,MXS_AUART_BASE=MXS_UARTAPP3_BASE,ENV_IS_IN_MMC"
# CONFIG_CMD_IMLS is not set
```

## configs/tqma28l_mba28l_defconfig
```kconfig
CONFIG_ARM=y
CONFIG_TARGET_TQMA28L=y
CONFIG_TQMA28L_MBA28L=y
CONFIG_SPL=y
CONFIG_SYS_EXTRA_OPTIONS="ENV_IS_IN_MMC,TQMA28L_MBA28L"
# CONFIG_CMD_IMLS is not set
```
